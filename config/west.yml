## config/west.yml
```yaml
manifest:
  remotes:
    - name: zmkfirmware
      url-base: https://github.com/zmkfirmware
  #    - name: petejohanson
  #      url-base: https://github.com/petejohanson
  projects:
    - name: zmk
      remote: zmkfirmware
      revision: v0.3
      import: app/west.yml
    # - name: zmk
    #   remote: petejohanson
    #   revision: core/ble-split-central-notify-main-thread
    #   import: app/west.yml
  self:
    path: config
```
